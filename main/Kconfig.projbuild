## main/Kconfig.projbuild
```kconfig
# put here your custom config value
menu "Example Configuration"
config ESP_WIFI_SSID
    string "WiFi SSID"
    default "SSID"
    help
	SSID (network name) for the example to connect to.

config ESP_WIFI_PASSWORD
    string "WiFi Password"
    default "mypassword"
    help
	WiFi password (WPA or WPA2) for the example to use.
config TCP_SERVER_IP
    string "TCP Server IP"
    default "192.168.0.4"
config TCP_SERVER_PORT
    int "TCP Server Port"
    range 0 65535
    default 80
endmenu
```
